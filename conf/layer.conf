## conf/layer.conf
```bitbake
# We have a conf and classes directory, add to BBPATH
BBPATH .= ":${LAYERDIR}"

# We have a recipes-* directories, add to BBFILES
BBFILES += "${LAYERDIR}/recipes-*/*/*.bb \
	${LAYERDIR}/recipes-*/*/*.bbappend"

BBFILE_COLLECTIONS += "nexell"

BBFILE_PATTERN_nexell = "^${LAYERDIR}/"
BBFILE_PRIORITY_nexell = "6"
```

## conf/machine/artik710-raptor.conf
```bitbake
#@TYPE: Machine
#@NAME: nexell

#@DESCRIPTION: Machine configuration for nexell systems

PREFERRED_PROVIDER_virtual/xserver ?= "xserver-xorg"
XSERVER ?= "xserver-xorg \
           xf86-input-evdev \
           xf86-input-mouse \
           xf86-video-fbdev \
           xf86-input-keyboard"

require conf/machine/include/arm/arch-arm64.inc
include conf/machine/include/nexell-base.inc
include conf/machine/include/artik7.inc

SERIAL_CONSOLE = "115200 ttyUSB0"
```

## conf/machine/avn-4418.conf
```bitbake
#@TYPE: Machine
#@NAME: nexell

#@DESCRIPTION: Machine configuration for nexell systems

PREFERRED_PROVIDER_virtual/xserver ?= "xserver-xorg"
XSERVER ?= "xserver-xorg \
           xf86-input-evdev \
           xf86-input-mouse \
           xf86-video-fbdev \
           xf86-input-keyboard"

require conf/machine/include/tune-cortexa9.inc
include conf/machine/include/nexell-base.inc
include conf/machine/include/avn-4418.inc

SERIAL_CONSOLE = "115200 ttyUSB0"
```

## conf/machine/avn.conf
```bitbake
#@TYPE: Machine
#@NAME: nexell

#@DESCRIPTION: Machine configuration for nexell systems

PREFERRED_PROVIDER_virtual/xserver ?= "xserver-xorg"
XSERVER ?= "xserver-xorg \
           xf86-input-evdev \
           xf86-input-mouse \
           xf86-video-fbdev \
           xf86-input-keyboard"

require conf/machine/include/arm/arch-armv7a.inc
include conf/machine/include/nexell-base.inc
include conf/machine/include/avn.inc

SERIAL_CONSOLE = "115200 ttyUSB0"
```

## conf/machine/include/artik7.inc
```bitbake
# artik7 BSP default providers

PREFERRED_PROVIDER_virtual/kernel ?= "linux-artik7"
PREFERRED_VERSION_linux-nexell ?= "4.1.%"
```

## conf/machine/include/artik7_mali.inc
```bitbake
# artik7 BSP default providers

PREFERRED_PROVIDER_virtual/kernel ?= "linux-artik7"
PREFERRED_VERSION_linux-nexell ?= "4.1.%"

PREFERRED_PROVIDER_virtual/libgles2 = "mali-nexell"
PREFERRED_PROVIDER_virtual/egl = "mali-nexell"
PREFERRED_PROVIDER_virtual/libgles1 = "mali-nexell"
PREFERRED_PROVIDER_virtual/libopencl ?= "mesa-gl"
PREFERRED_PROVIDER_virtual/libgl ?= "mesa-gl"
PREFERRED_PROVIDER_virtual/mesa ?= "mesa-gl"

MULTILIBS = "multilib:lib32 multilib:lib64"

TINY_GUI_DEFAULT_DISTRO_FEATURES = ""
TINY_GUI_DEFAULT_EXTRA_RDEPENDS = "packagegroup-core-boot"

DISTRO_FEATURES ?= "${DISTRO_FEATURES_DEFAULT} ${DISTRO_FEATURES_LIBC} ${TINY_GUI_DEFAULT_DISTRO_FEATURES}"

DISTRO_EXTRA_RDEPENDS += "${TINY_GUI_DEFAULT_EXTRA_RDEPENDS}"

SDK_NAME = "${DISTRO}-${TCLIBC}-${SDK_ARCH}-${IMAGE_BASENAME}-${TUNE_PKGARCH}"
SDKPATH = "/opt/${DISTRO}/${SDK_VERSION}"

TCLIBCAPPEND = ""
```

## conf/machine/include/avn-4418.inc
```bitbake
# artik7 BSP default providers

PREFERRED_PROVIDER_virtual/kernel ?= "linux-avn-4418"
PREFERRED_VERSION_linux-nexell ?= "4.1.%"
```

## conf/machine/include/avn.inc
```bitbake
# artik7 BSP default providers

PREFERRED_PROVIDER_virtual/kernel ?= "linux-avn"
PREFERRED_VERSION_linux-nexell ?= "4.1.%"
```

## conf/machine/include/nexell-base.inc
```bitbake
SOC_FAMILY = "Nexell"
#include conf/machine/include/soc-family.inc

IMAGE_FSTYPES ?= "tar.bz2 ext4"
INITRAMFS_IMAGE = "nexell-ramdisk"

KERNEL_IMAGETYPE_s5p6818-artik710-raptor ?= "Image"
KERNEL_IMAGETYPE_s5p6818-avn-ref ?= "Image"
KERNEL_IMAGETYPE_s5p4418-navi-ref ?= "zImage"
KERNEL_IMAGETYPE_s5p4418-avn-ref ?= "zImage"
KERNEL_IMAGETYPE_s5p4418-smart-voice ?= "zImage"
KERNEL_IMAGETYPE_s5p4418-daudio-ref ?= "zImage"
KERNEL_IMAGETYPE_s5p6818-kick-st ?= "Image"

MACHINE_FEATURES += "apm usbhost keyboard vfat ext2 screen mouse touchscreen bluetooth wifi sdio"

MACHINE_FEATURES_BACKFILL_CONSIDERED = "rtc"

MACHINE_EXTRA_RRECOMMENDS += "kernel-modules kernel-devicetree"

DEFAULTTUNE_s5p6818-artik710-raptor ?= "aarch64"
DEFAULTTUNE_s5p6818-avn-ref ?= "aarch64"
DEFAULTTUNE_s5p4418-avn-ref ?= "cortexa9hf-neon"
DEFAULTTUNE_s5p4418-navi-ref ?= "cortexa9hf-neon"
DEFAULTTUNE_s5p4418-daudio-ref ?= "cortexa9hf-neon"
DEFAULTTUNE_s5p4418-smart-voice ?= "cortexa9hf-neon"
DEFAULTTUNE_s5p6818-kick-st ?= "aarch64"

DEFAULT_TIMEZONE="Asia/Seoul"
```

## conf/machine/include/s5p4418-cluster-ref.inc
```bitbake
# navi-4418 BSP default providers

PREFERRED_PROVIDER_virtual/kernel ?= "linux-s5p4418-cluster-ref"
PREFERRED_VERSION_linux-nexell ?= "4.4.%"
```

## conf/machine/include/s5p4418-daudio-cona.inc
```bitbake
# navi-4418 BSP default providers

PREFERRED_PROVIDER_virtual/kernel ?= "linux-s5p4418-daudio-cona"
PREFERRED_VERSION_linux-nexell ?= "4.4.%"
```

## conf/machine/include/s5p4418-ff-voice.inc
```bitbake
# smart_voice-4418 BSP default providers

PREFERRED_PROVIDER_virtual/kernel ?= "linux-s5p4418-ff-voice"
PREFERRED_VERSION_linux-nexell ?= "4.4.%"
```

## conf/machine/include/s5p4418-navi-ref.inc
```bitbake
# navi-4418 BSP default providers

PREFERRED_PROVIDER_virtual/kernel ?= "linux-s5p4418-navi-ref"
PREFERRED_VERSION_linux-nexell ?= "4.1.%"
```

## conf/machine/include/s5p6818-artik710-raptor.inc
```bitbake
# artik7 BSP default providers

PREFERRED_PROVIDER_virtual/kernel ?= "linux-s5p6818-artik710-raptor"
PREFERRED_VERSION_linux-nexell ?= "4.4.%"
```

## conf/machine/include/s5p6818-kick-st.inc
```bitbake
# kboard BSP default providers

PREFERRED_PROVIDER_virtual/kernel ?= "linux-s5p6818-kick-st"
PREFERRED_VERSION_linux-nexell ?= "4.4.%"
```

## conf/machine/s5p4418-avn-ref.conf
```bitbake
#@TYPE: Machine
#@NAME: nexell

#@DESCRIPTION: Machine configuration for nexell systems
require conf/machine/include/tune-cortexa9.inc
include conf/machine/include/nexell-base.inc
include conf/machine/include/s5p4418-avn-ref.inc
```

## conf/machine/s5p4418-cluster-ref.conf
```bitbake
#@TYPE: Machine
#@NAME: nexell

#@DESCRIPTION: Machine configuration for nexell systems

# PREFERRED_PROVIDER_virtual/xserver ?= "xserver-xorg"
# XSERVER ?= "xserver-xorg \
#            xf86-input-evdev \
#            xf86-input-mouse \
#            xf86-video-fbdev \
#            xf86-input-keyboard"

require conf/machine/include/tune-cortexa9.inc
include conf/machine/include/nexell-base.inc
include conf/machine/include/s5p4418-cluster-ref.inc

# ------------------------------------------------------------
# ROOTFS Size
# ------------------------------------------------------------
# daudio rootfs size = 512 Mbyte
# 524288 Kbyte
# ------------------------------------------------------------
# Reserved yocto extra space = 102400 Kbyte for pkg. install
# IMAGE_ROOTFS_EXTRA_SPACE="0 + 102400"
# ------------------------------------------------------------
# So, 524288 - 51200(Krogoth) = 473088 Kbyte
# ------------------------------------------------------------
IMAGE_ROOTFS_SIZE = "1048576"
```

## conf/machine/s5p4418-daudio-cona.conf
```bitbake
#@TYPE: Machine
#@NAME: nexell

#@DESCRIPTION: Machine configuration for nexell systems
require conf/machine/include/tune-cortexa9.inc
include conf/machine/include/nexell-base.inc
include conf/machine/include/s5p4418-daudio-cona.inc

# override touch class in nexell-base, 'PRESSES'
NEXELL_TOUCH_CLASS = "CAPACITIVE"

# ------------------------------------------------------------
# ROOTFS Size
# ------------------------------------------------------------
# daudio rootfs size = 512 Mbyte
# 524288 Kbyte
# ------------------------------------------------------------
# Reserved yocto extra space = 102400 Kbyte for pkg. install
# IMAGE_ROOTFS_EXTRA_SPACE="0 + 102400"
# ------------------------------------------------------------
# So, 524288 - 51200(Krogoth) = 473088 Kbyte
# ------------------------------------------------------------
IMAGE_ROOTFS_SIZE = "997376"
```

## conf/machine/s5p4418-ff-voice.conf
```bitbake
#@TYPE: Machine
#@NAME: nexell

#@DESCRIPTION: Machine configuration for nexell systems
require conf/machine/include/tune-cortexa9.inc
include conf/machine/include/nexell-base.inc
include conf/machine/include/s5p4418-ff-voice.inc

CORE_IMAGE_EXTRA_INSTALL += "dhcp-server dhcp-client"
CORE_IMAGE_EXTRA_INSTALL += "iw wpa-supplicant wireless-tools"
```

## conf/machine/s5p4418-navi-ref.conf
```bitbake
#@TYPE: Machine
#@NAME: nexell

#@DESCRIPTION: Machine configuration for nexell systems

PREFERRED_PROVIDER_virtual/xserver ?= "xserver-xorg"
XSERVER ?= "xserver-xorg \
           xf86-input-evdev \
           xf86-input-mouse \
           xf86-video-fbdev \
           xf86-input-keyboard"

require conf/machine/include/tune-cortexa9.inc
include conf/machine/include/nexell-base.inc
include conf/machine/include/s5p4418-navi-ref.inc

SERIAL_CONSOLE = "115200 ttyUSB0"
```

## conf/machine/s5p4418-smart-voice.conf
```bitbake
#@TYPE: Machine
#@NAME: nexell

#@DESCRIPTION: Machine configuration for nexell systems
require conf/machine/include/tune-cortexa9.inc
include conf/machine/include/nexell-base.inc
include conf/machine/include/s5p4418-smart-voice.inc

CORE_IMAGE_EXTRA_INSTALL += "dhcp-server dhcp-client"
CORE_IMAGE_EXTRA_INSTALL += "iw wpa-supplicant wireless-tools"

# ------------------------------------------------------------
# ROOTFS Size
# ------------------------------------------------------------
# smart-voice rootfs size = 7.3GiB
# 7GiB ==> 7340032KB
# ------------------------------------------------------------
# Reserved yocto extra space = 51200 Kbyte for pkg. install
# Krogoth => 51200
# Pyro ==> 102400
# ------------------------------------------------------------
# Real RootFS Size =  7340032 - 51200 -32 = 7288800 KB
# ------------------------------------------------------------
IMAGE_ROOTFS_SIZE = "7288800"
```

## conf/machine/s5p6818-artik710-raptor.conf
```bitbake
#@TYPE: Machine
#@NAME: nexell

#@DESCRIPTION: Machine configuration for nexell systems
require conf/machine/include/arm/arch-arm64.inc
include conf/machine/include/nexell-base.inc
include conf/machine/include/s5p6818-artik710-raptor.inc

QEMU_TARGETS_append = " aarch64"
```

## conf/machine/s5p6818-avn-ref.conf
```bitbake
#@TYPE: Machine
#@NAME: nexell

#@DESCRIPTION: Machine configuration for nexell systems
require conf/machine/include/arm/arch-arm64.inc
include conf/machine/include/nexell-base.inc
include conf/machine/include/s5p6818-avn-ref.inc

QEMU_TARGETS_append = " aarch64"
```

## conf/machine/s5p6818-kick-st.conf
```bitbake
#@TYPE: Machine
#@NAME: nexell

#@DESCRIPTION: Machine configuration for nexell systems
require conf/machine/include/arm/arch-arm64.inc
include conf/machine/include/nexell-base.inc
include conf/machine/include/s5p6818-kick-st.inc

QEMU_TARGETS_append = " aarch64"

# override touch class in nexell-base, 'PRESSES'
NEXELL_TOUCH_CLASS = "CAPACITIVE"
```

## meta-nexell-distro/conf/machine/include/nexell-base.inc
```bitbake
inherit linux-nexell-base

SOC_FAMILY = "Nexell"

IMAGE_FSTYPES ?= "tar.bz2 ext4"
INITRAMFS_IMAGE ?= "nexell-ramdisk"

# If you need to change below function, you can see the classes/linux-nexell-base.bbclass
KERNEL_IMAGETYPE_${MACHINE} ?= "${@get_kernel_image_type(d,"${MACHINE}")}"
DEFAULTTUNE_${MACHINE} ?= "${@get_defaulttune_type(d,"${MACHINE}")}"

MACHINE_FEATURES += "apm usbhost keyboard vfat ext2 screen mouse touchscreen bluetooth wifi sdio"
MACHINE_FEATURES_BACKFILL_CONSIDERED = "rtc"
MACHINE_EXTRA_RRECOMMENDS += "kernel-modules kernel-devicetree"

DEFAULT_TIMEZONE="Asia/Seoul"

IMAGE_OVERHEAD_FACTOR="1.0"

PREFERRED_PROVIDER_virtual/kernel ?= "linux-${NEXELL_BOARD_SOCNAME}"
PREFERRED_PROVIDER_virtual/bootloader ?= "u-boot-nexell"

# default type is pressure sensitive touch screen
# If yoc need another type, override 'NEXELL_TOUCH_CLASS' in machine/conf/<board_name>
NEXELL_TOUCH_CLASS = "PRESSES"
```
