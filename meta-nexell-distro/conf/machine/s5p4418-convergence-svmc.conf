## meta-nexell-distro/conf/machine/s5p4418-convergence-svmc.conf
```bitbake
#@TYPE: Machine
#@NAME: nexell

NEXELL_BOARD_SOCNAME = "s5p4418"

#@DESCRIPTION: Machine configuration for nexell systems
require conf/machine/include/tune-cortexa9.inc
include conf/machine/include/nexell-base.inc

# 32bit machine = 32/arm, 64bit machine = 64/arm64
ARCH_TYPE_NUM = "32"
ARCH_TYPE = "arm32"

# Nexell Kernel Configuration
KERNEL_DEVICETREE = "s5p4418-convergence_svmc-rev00.dtb"
KBUILD_DEFCONFIG = "s5p4418_convergence_svmc_defconfig"
#MACHINE_ESSENTIAL_EXTRA_RRECOMMENDS += "rtl-8188eus-32"
#MACHINE_ESSENTIAL_EXTRA_RRECOMMENDS += "kernel-modules"

# Nexell U-BOOT Configuration
UBOOT_DEFCONFIG = "s5p4418_convergence_svmc_defconfig"

# Nexell 2ndBoot Configuration
BL1_BUILD_CONFIG='BOARD="convergence_svmc" KERNEL_VER="4" ARM_SECURE="n" CHIPNAME="nxp4330" DEVICE_PORT="0" SYSLOG="n"'
BL1_BIN='bl1-convergence_svmc.bin'
BL1_FINAL_BIN='bl1-convergence.bin'
BL1_EMMCBOOT='bl1-emmcboot.bin'

# Nexell bl2 Configuration
DISPATCHER_BUILD_CONFIG='BOARD="CONVERGENCESVMC"'
DISPATCHER_BIN='armv7_dispatcher.bin'

# ------------------------------------------------------------
# ROOTFS Size
# ------------------------------------------------------------
# $fastboot getvar capacity.mmc.0
# 7818182656 - 0x4400000 = 7746879488
# Available rootfs Size = 7565312 Kbyte
# ------------------------------------------------------------
# Reserved yocto extra space = 102400 Kbyte for pkg. install
# IMAGE_ROOTFS_EXTRA_SPACE="0 + 102400"
# ------------------------------------------------------------
# So, 7565312 - 102400(pyro) = 7462912 Kbyte
# ------------------------------------------------------------
# IMAGE_ROOTFS_SIZE = "2097152"
# ------------------------------------------------------------
# 2018.10.05 change
# ------------------------------------------------------------
# ROOTFS = 1024MB - 128MB
# USERDATA = 6144MB(6GB)
# ------------------------------------------------------------
IMAGE_ROOTFS_SIZE = "917504"
```

## meta-nexell-distro/conf/machine/s5p4418-daudio-covi.conf
```bitbake
#@TYPE: Machine
#@NAME: nexell

NEXELL_BOARD_SOCNAME = "s5p4418"

#@DESCRIPTION: Machine configuration for nexell systems
require conf/machine/include/tune-cortexa9.inc
include conf/machine/include/nexell-base.inc

# 32bit machine = 32/arm, 64bit machine = 64/arm64
ARCH_TYPE_NUM = "32"
ARCH_TYPE = "arm32"

# Nexell Kernel Configuration
KERNEL_DEVICETREE = "s5p4418-daudio_covi-rev00.dtb"
KBUILD_DEFCONFIG = "s5p4418_daudio_covi_defconfig"

# Nexell U-BOOT Configuration
UBOOT_DEFCONFIG = "s5p4418_daudio_covi_defconfig"

# Nexell 2ndBoot Configuration
BL1_BUILD_CONFIG='BOARD="daudio" KERNEL_VER="4" ARM_SECURE="n" CHIPNAME="nxp4330" DEVICE_PORT="0" SYSLOG="n"'
BL1_BIN='bl1-daudio.bin'
BL1_FINAL_BIN='bl1-daudio.bin'
BL1_EMMCBOOT='bl1-emmcboot.bin'

# Nexell bl2 Configuration
DISPATCHER_BUILD_CONFIG='BOARD="DAUDIOCOVI"'
DISPATCHER_BIN='armv7_dispatcher.bin'

# ------------------------------------------------------------
# ROOTFS Size
# ------------------------------------------------------------
# daudio rootfs size = 512 Mbyte
# 524288 Kbyte
# ------------------------------------------------------------
# Reserved yocto extra space = 102400 Kbyte for pkg. install
# IMAGE_ROOTFS_EXTRA_SPACE="0 + 102400"
# ------------------------------------------------------------
# So, 524288 - 51200(Krogoth) = 473088 Kbyte
# ------------------------------------------------------------
IMAGE_ROOTFS_SIZE = "473088"

# override touch class, capacitive touchscreen
NEXELL_TOUCH_CLASS = "CAPACITIVE"
```

## meta-nexell-distro/conf/machine/s5p4418-daudio-ref.conf
```bitbake
#@TYPE: Machine
#@NAME: nexell

NEXELL_BOARD_SOCNAME = "s5p4418"

#@DESCRIPTION: Machine configuration for nexell systems
require conf/machine/include/tune-cortexa9.inc
include conf/machine/include/nexell-base.inc

# 32bit machine = 32/arm, 64bit machine = 64/arm64
ARCH_TYPE_NUM = "32"
ARCH_TYPE = "arm32"

# Nexell quickboot enabler
QUICKBOOT_ENABLE = "1"

# Nexell Kernel Configuration
KERNEL_DEVICETREE = "s5p4418-daudio_ref-rev00.dtb s5p4418-daudio_ref-rev01.dtb"
KBUILD_DEFCONFIG = "s5p4418_daudio_ref_defconfig"

# Nexell U-BOOT Configuration
UBOOT_DEFCONFIG = "s5p4418_daudio_ref_defconfig"

# Nexell 2ndBoot Configuration
BL1_BUILD_CONFIG='BOARD="navi" KERNEL_VER="4" ARM_SECURE="n" CHIPNAME="nxp4330" DEVICE_PORT="0" SYSLOG="n"'
BL1_BIN='bl1-navi.bin'
BL1_FINAL_BIN='bl1-daudio.bin'
BL1_EMMCBOOT='bl1-emmcboot.bin'

# Nexell bl2 Configuration
DISPATCHER_BUILD_CONFIG='BOARD="NAVI"'
DISPATCHER_BIN='armv7_dispatcher.bin'

# ------------------------------------------------------------
# ROOTFS Size
# ------------------------------------------------------------
# $fastboot getvar capacity.mmc.0
# 7818182656 - 0x4400000 = 7746879488
# Available rootfs Size = 7565312 Kbyte
# ------------------------------------------------------------
# Reserved yocto extra space = 102400 Kbyte for pkg. install
# IMAGE_ROOTFS_EXTRA_SPACE="0 + 102400"
# ------------------------------------------------------------
# So, 7565312 - 102400 = 7462912 Kbyte
# DAUDIO 768MB, 786432 - 102400 = 684032 Kbyte
# ------------------------------------------------------------
IMAGE_ROOTFS_SIZE = "684032"

# for bt alsa audio path
NXBT_ALSA_AUDIO_PATH_PLAYBACK = "plughw:0,0"
NXBT_ALSA_AUDIO_PATH_CAPTURE = "plughw:0,0"
NXBT_ALSA_AUDIO_PATH_SCO_PLAYBACK = "plughw:0,2"
NXBT_ALSA_AUDIO_PATH_SCO_CAPTURE = "plughw:0,2"
```

## meta-nexell-distro/conf/machine/s5p4418-navi-ref.conf
```bitbake
#@TYPE: Machine
#@NAME: nexell

NEXELL_BOARD_SOCNAME = "s5p4418"

#@DESCRIPTION: Machine configuration for nexell systems
require conf/machine/include/tune-cortexa9.inc
include conf/machine/include/nexell-base.inc

# 32bit machine = 32/arm, 64bit machine = 64/arm64
ARCH_TYPE_NUM = "32"
ARCH_TYPE = "arm32"

# Nexell Kernel Configuration
KERNEL_DEVICETREE = "s5p4418-navi_ref-rev00.dtb s5p4418-navi_ref-rev01.dtb"
KBUILD_DEFCONFIG = "s5p4418_navi_ref_defconfig"
#MACHINE_ESSENTIAL_EXTRA_RRECOMMENDS += "rtl-8188eus-32"
#MACHINE_ESSENTIAL_EXTRA_RRECOMMENDS += "kernel-modules"

# Nexell U-BOOT Configuration
UBOOT_DEFCONFIG = "s5p4418_navi_ref_defconfig"

# Nexell 2ndBoot Configuration
BL1_BUILD_CONFIG='BOARD="navi" KERNEL_VER="4" ARM_SECURE="n" CHIPNAME="nxp4330" DEVICE_PORT="0" SYSLOG="n"'
BL1_BIN='bl1-navi.bin'
BL1_FINAL_BIN='bl1-navi.bin'
BL1_EMMCBOOT='bl1-emmcboot.bin'

# Nexell bl2 Configuration
DISPATCHER_BUILD_CONFIG='BOARD="NAVI"'
DISPATCHER_BIN='armv7_dispatcher.bin'

# ------------------------------------------------------------
# ROOTFS Size
# ------------------------------------------------------------
# $fastboot getvar capacity.mmc.0
# 7818182656 - 0x4400000 = 7746879488
# Available rootfs Size = 7565312 Kbyte
# ------------------------------------------------------------
# Reserved yocto extra space = 102400 Kbyte for pkg. install
# IMAGE_ROOTFS_EXTRA_SPACE="0 + 102400"
# ------------------------------------------------------------
# So, 7565312 - 102400(pyro) = 7462912 Kbyte
# ------------------------------------------------------------
IMAGE_ROOTFS_SIZE = "7462912"
```

## meta-nexell-distro/conf/machine/s5p4418-smart-voice.conf
```bitbake
#@TYPE: Machine
#@NAME: nexell

NEXELL_BOARD_SOCNAME = "s5p4418"

#@DESCRIPTION: Machine configuration for nexell systems
require conf/machine/include/tune-cortexa9.inc
include conf/machine/include/nexell-base.inc

# 32bit machine = 32/arm, 64bit machine = 64/arm64
ARCH_TYPE_NUM = "32"
ARCH_TYPE = "arm32"

# Nexell Kernel Configuration
KERNEL_DEVICETREE = "s5p4418-smart_voice.dtb"
KBUILD_DEFCONFIG = "s5p4418_smart_voice_defconfig"

# Nexell U-BOOT Configuration
UBOOT_DEFCONFIG = "s5p4418_smart_voice_defconfig"

# Nexell 2ndBoot Configuration
BL1_BUILD_CONFIG='BOARD="smart_voice" KERNEL_VER="4" ARM_SECURE="n" CHIPNAME="nxp4330" DEVICE_PORT="0" SYSLOG="n"'
BL1_BIN='bl1-smart_voice.bin'
BL1_FINAL_BIN='bl1-smart_voice.bin'
BL1_EMMCBOOT='bl1-emmcboot.bin'

# Nexell bl2 Configuration
DISPATCHER_BUILD_CONFIG='BOARD="SMARTVOICE"'
DISPATCHER_BIN='armv7_dispatcher.bin'

# ------------------------------------------------------------
# ROOTFS Size
# ------------------------------------------------------------
# smart-voice rootfs size = 7.3GiB
# 7GiB ==> 7340032KB
# ------------------------------------------------------------
# Reserved yocto extra space = 51200 Kbyte for pkg. install
# Krogoth => 51200
# Pyro ==> 102400
# ------------------------------------------------------------
# Real RootFS Size =  7340032 - 102400 -32 = 7237600 KB
# ------------------------------------------------------------
# IMAGE_ROOTFS_SIZE = "7237600"
# ------------------------------------------------------------
# 2018.10.05 change
# ------------------------------------------------------------
# ROOTFS = 1024MB - 128MB
# USERDATA = 6144MB(6GB)
# ------------------------------------------------------------
IMAGE_ROOTFS_SIZE = "917504"
```

## meta-nexell-distro/conf/machine/s5p4418-svt-ref.conf
```bitbake
#@TYPE: Machine
#@NAME: nexell

NEXELL_BOARD_SOCNAME = "s5p4418"

#@DESCRIPTION: Machine configuration for nexell systems
require conf/machine/include/tune-cortexa9.inc
include conf/machine/include/nexell-base.inc

# 32bit machine = 32/arm, 64bit machine = 64/arm64
ARCH_TYPE_NUM = "32"
ARCH_TYPE = "arm32"

# Nexell Kernel Configuration
KERNEL_DEVICETREE = "s5p4418-svt_ref-rev00.dtb s5p4418-svt_ref-rev01.dtb"
KBUILD_DEFCONFIG ?= "s5p4418_svt_ref_defconfig"
#MACHINE_ESSENTIAL_EXTRA_RRECOMMENDS += "rtl-8188eus-32"
#MACHINE_ESSENTIAL_EXTRA_RRECOMMENDS += "kernel-modules"

# Nexell U-BOOT Configuration
UBOOT_DEFCONFIG = "s5p4418_svt_ref_defconfig"

# Nexell 2ndBoot Configuration
BL1_BUILD_CONFIG='BOARD="svt" KERNEL_VER="4" ARM_SECURE="n" CHIPNAME="s5p4418" DEVICE_PORT="0" SYSLOG="n"'
BL1_BIN='bl1-svt.bin'
BL1_FINAL_BIN='bl1-svt.bin'
BL1_EMMCBOOT='bl1-emmcboot.bin'

# Nexell bl2 Configuration
DISPATCHER_BUILD_CONFIG='BOARD="SVT"'
DISPATCHER_BIN='armv7_dispatcher.bin'

# ------------------------------------------------------------
# ROOTFS Size
# ------------------------------------------------------------
# $fastboot getvar capacity.mmc.0
# 7818182656 - 0x4400000 = 7746879488
# Available rootfs Size = 7565312 Kbyte
# ------------------------------------------------------------
# Reserved yocto extra space = 102400 Kbyte for pkg. install
# IMAGE_ROOTFS_EXTRA_SPACE="0 + 102400"
# ------------------------------------------------------------
# So, 7565312 - 102400 = 7462912 Kbyte
# DAUDIO 768MB, 786432 - 102400 = 684032 Kbyte
# ------------------------------------------------------------
IMAGE_ROOTFS_SIZE = "684032"
```

## meta-nexell-distro/conf/machine/s5p4418-zh-dragon.conf
```bitbake
#@TYPE: Machine
#@NAME: nexell

NEXELL_BOARD_SOCNAME = "s5p4418"

#@DESCRIPTION: Machine configuration for nexell systems
require conf/machine/include/tune-cortexa9.inc
include conf/machine/include/nexell-base.inc

# 32bit machine = 32/arm, 64bit machine = 64/arm64
ARCH_TYPE_NUM = "32"
ARCH_TYPE = "arm32"

# Nexell Kernel Configuration
KERNEL_DEVICETREE = "s5p4418-zh_dragon-rev00.dtb"
KBUILD_DEFCONFIG = "s5p4418_zh_dragon_defconfig"

# Nexell U-BOOT Configuration
UBOOT_DEFCONFIG = "s5p4418_zh_dragon_defconfig"

# Nexell 2ndBoot Configuration
BL1_BUILD_CONFIG='BOARD="zh_dragon" KERNEL_VER="4" ARM_SECURE="n" CHIPNAME="nxp4330" DEVICE_PORT="0" SYSLOG="n"'
BL1_BIN='bl1-zh_dragon.bin'
BL1_FINAL_BIN='bl1-zh_dragon.bin'
BL1_EMMCBOOT='bl1-emmcboot.bin'

# Nexell bl2 Configuration
DISPATCHER_BUILD_CONFIG='BOARD="NAVI"'
DISPATCHER_BIN='armv7_dispatcher.bin'

# ------------------------------------------------------------
# ROOTFS Size
# ------------------------------------------------------------
# $fastboot getvar capacity.mmc.0
# 7818182656 - 0x4400000 = 7746879488
# Available rootfs Size = 7565312 Kbyte
# ------------------------------------------------------------
# Reserved yocto extra space = 102400 Kbyte for pkg. install
# IMAGE_ROOTFS_EXTRA_SPACE="0 + 102400"
# ------------------------------------------------------------
# So, 7565312 - 102400(pyro) = 7462912 Kbyte
# ------------------------------------------------------------
IMAGE_ROOTFS_SIZE = "7462912"
```

## meta-nexell-distro/conf/machine/s5p6818-avn-ref.conf
```bitbake
#@TYPE: Machine
#@NAME: nexell

NEXELL_BOARD_SOCNAME = "s5p6818"

#@DESCRIPTION: Machine configuration for nexell systems
require conf/machine/include/arm/arch-arm64.inc
include conf/machine/include/nexell-base.inc

QEMU_TARGETS_append = " aarch64"

# 32bit machine = 32/arm, 64bit machine = 64/arm64
ARCH_TYPE_NUM = "64"
ARCH_TYPE = "arm64"

# Nexell quickboot enabler
QUICKBOOT_ENABLE = "1"

# Nexell Kernel Configuration
KERNEL_DEVICETREE = "nexell/s5p6818-avn-ref-rev01.dtb"
KERNEL_DTB_NAME = "s5p6818-avn-ref-rev01.dtb"
KBUILD_DEFCONFIG ?= "s5p6818_avn_ref_defconfig"

# Nexell U-BOOT Configuration
UBOOT_DEFCONFIG = "s5p6818_avn_ref_defconfig"

# Nexell 2ndBoot Configuration
BL1_BUILD_CONFIG='BOARD="avn" KERNEL_VER="4" SYSLOG="n" DEVICE_PORT="2"'
BL1_BIN='bl1-avn.bin'
BL1_FINAL_BIN='bl1-avn.bin'
BL1_EMMCBOOT='bl1-emmcboot.bin'

# Nexell optee Configuration, only s5p6818
OPTEE_PLAT_DRAM_SIZE="2048"
OPTEE_BUILD_TARGET_SOCNAME="s5p6818"
OPTEE_BUILD_TARGET_MACHINE="s5p6818-avn-ref"
IMAGE_INSTALL_append = " optee-linuxdriver optee-build"

TOOLCHAIN_AARCH64_PREBUILT = "gcc-linaro-4.9-2015.05-x86_64_aarch64-linux-gnu"

# ------------------------------------------------------------
# ROOTFS Size
# ------------------------------------------------------------
# $fastboot getvar capacity.mmc.0
# 7818182656 - 0x6400000 = 7713325056
# Available rootfs Size = 7532544 Kbyte
# ------------------------------------------------------------
# Reserved yocto extra space = 102400 Kbyte for pkg. install
# IMAGE_ROOTFS_EXTRA_SPACE="0 + 102400"
# ------------------------------------------------------------
# So, 7532544 - 102400(pyro) - 32768(margin)= 7397376 Kbyte
# ------------------------------------------------------------
# IMAGE_ROOTFS_SIZE = "7397376"
# ------------------------------------------------------------
# 2018.10.05 change
# ------------------------------------------------------------
# ROOTFS = 1024MB - 128MB
# USERDATA = 6144MB(6GB)
# ------------------------------------------------------------
IMAGE_ROOTFS_SIZE = "917504"
```
