## meta-nexell-distro/conf/machine/s5p6818-kick-st.conf
```bitbake
#@TYPE: Machine
#@NAME: nexell

NEXELL_BOARD_SOCNAME = "s5p6818"

#@DESCRIPTION: Machine configuration for nexell systems
require conf/machine/include/arm/arch-arm64.inc
include conf/machine/include/nexell-base.inc

QEMU_TARGETS_append = " aarch64"

# 32bit machine = 32/arm, 64bit machine = 64/arm64
ARCH_TYPE_NUM = "64"
ARCH_TYPE = "arm64"

# Nexell Kernel Configuration
KERNEL_DEVICETREE = "nexell/s5p6818-kick-st.dtb nexell/s5p6818-kick-st-rev00.dtb"
KERNEL_DTB_NAME = "s5p6818-kick-st-rev00.dtb"
KBUILD_DEFCONFIG = "s5p6818_kick_st_defconfig"

# Nexell U-BOOT Configuration
UBOOT_DEFCONFIG = "s5p6818_kick_st_defconfig"

# Nexell 2ndBoot Configuration
BL1_BUILD_CONFIG='BOARD="kick_st" KERNEL_VER="4" SYSLOG="n" DEVICE_PORT="2"'
BL1_BIN='bl1-kick_st.bin'
BL1_FINAL_BIN='bl1-kick_st.bin'
BL1_EMMCBOOT='bl1-emmcboot.bin'

# Nexell optee Configuration, only s5p6818
OPTEE_PLAT_DRAM_SIZE="2048"
OPTEE_BUILD_TARGET_SOCNAME="s5p6818"
OPTEE_BUILD_TARGET_MACHINE="s5p6818-kick-st"
IMAGE_INSTALL_append = " optee-linuxdriver optee-build"

# ------------------------------------------------------------
# ROOTFS Size
# ------------------------------------------------------------
# $fastboot getvar capacity.mmc.0
# 7818182656 - 0x6400000 = 7713325056
# Available rootfs Size = 7532544 Kbyte
# ------------------------------------------------------------
# Reserved yocto extra space = 102400 Kbyte for pkg. install
# IMAGE_ROOTFS_EXTRA_SPACE="0 + 102400"
# ------------------------------------------------------------
# So, 7532544 - 102400(pyro) - 16384(margin)= 7413760 Kbyte
# ------------------------------------------------------------
IMAGE_ROOTFS_SIZE = "7413760"

# override touch class, capacitive touchscreen
NEXELL_TOUCH_CLASS = "CAPACITIVE"
```

## meta-nexell-distro/conf/machine/s5p6818-svt-ref.conf
```bitbake
#@TYPE: Machine
#@NAME: nexell

NEXELL_BOARD_SOCNAME = "s5p6818"

#@DESCRIPTION: Machine configuration for nexell systems
require conf/machine/include/arm/arch-arm64.inc
include conf/machine/include/nexell-base.inc

QEMU_TARGETS_append = " aarch64"

# 32bit machine = 32/arm, 64bit machine = 64/arm64
ARCH_TYPE_NUM = "64"
ARCH_TYPE = "arm64"

# Nexell Kernel Configuration
KERNEL_DEVICETREE = "nexell/s5p6818-svt-ref-rev00.dtb"
KERNEL_DTB_NAME = "s5p6818-svt-ref-rev00.dtb"
KBUILD_DEFCONFIG = "s5p6818_svt_ref_defconfig"

# Nexell U-BOOT Configuration
UBOOT_DEFCONFIG = "s5p6818_svt_ref_defconfig"

# Nexell 2ndBoot Configuration
BL1_BUILD_CONFIG='BOARD="svt" KERNEL_VER="4" SYSLOG="y" DEVICE_PORT="0"'
BL1_BIN='bl1-svt.bin'
BL1_FINAL_BIN='bl1-svt.bin'
BL1_EMMCBOOT='bl1-emmcboot.bin'

# Nexell optee Configuration, only s5p6818
OPTEE_PLAT_DRAM_SIZE="1024"
OPTEE_PLAT_UART_BASE="0xC00A1000"
OPTEE_BUILD_TARGET_SOCNAME="s5p6818"
OPTEE_BUILD_TARGET_MACHINE="s5p6818-svt-ref"
IMAGE_INSTALL_append = " optee-linuxdriver optee-build"

TOOLCHAIN_AARCH64_PREBUILT = "gcc-linaro-4.9-2015.05-x86_64_aarch64-linux-gnu"

# Nexell override
SERIAL_CONSOLE = "115200 ttySAC0"

# ------------------------------------------------------------
# ROOTFS Size
# ------------------------------------------------------------
# $fastboot getvar capacity.mmc.0
# 7818182656 - 0x6400000 = 7713325056
# Available rootfs Size = 7532544 Kbyte
# ------------------------------------------------------------
# Reserved yocto extra space = 102400 Kbyte for pkg. install
# IMAGE_ROOTFS_EXTRA_SPACE="0 + 102400"
# ------------------------------------------------------------
# So, 7532544 - 102400(pyro) - 32768(margin)= 7397376 Kbyte
# ------------------------------------------------------------
# IMAGE_ROOTFS_SIZE = "7397376"
# ------------------------------------------------------------
# 2018.10.05 change
# ------------------------------------------------------------
# ROOTFS = 1024MB - 128MB
# USERDATA = 6144MB(6GB)
# ------------------------------------------------------------
IMAGE_ROOTFS_SIZE = "917504"
```

## meta-nxp3220/conf/layer.conf
```bitbake
# We have a conf and classes directory, add to BBPATH
BBPATH .= ":${LAYERDIR}"

# We have a recipes-* directories, add to BBFILES
BBFILES += "${LAYERDIR}/recipes-*/*/*.bb \
	${LAYERDIR}/recipes-*/*/*.bbappend"

BBFILE_COLLECTIONS += "nxp3220"
BBFILE_PATTERN_nxp3220 = "^${LAYERDIR}/"
BBFILE_PRIORITY_nxp3220 = "6"

LAYERSERIES_COMPAT_nxp3220 = "sumo"
LAYERSERIES_COMPAT_nexell = "sumo"
```

## meta-nxp3220/conf/machine/include/nxp3220.inc
```bitbake
include conf/machine/include/tune-cortexa7.inc

DEFAULTTUNE = "cortexa7hf-neon"

EXTRA_IMAGEDEPENDS += "u-boot"

MACHINE_EXTRA_RRECOMMENDS = " kernel-modules kernel-devicetree"
LINUX_VERSION ?= "4.14"

# Skip do_kernel_version_sanity_check
KERNEL_VERSION_SANITY_SKIP = "1"

UBOOT_VERSION ?= "2018.5"
UBOOT_SUFFIX = "bin"
IMAGE_BOOT_FILES ?= "u-boot.${UBOOT_SUFFIX}"

PREFERRED_PROVIDER_u-boot ?= "u-boot-${UBOOT_VERSION}-nexell"
PREFERRED_PROVIDER_virtual/bootloader ?= "u-boot-${UBOOT_VERSION}-nexell"
PREFERRED_PROVIDER_virtual/kernel ?= "linux-${LINUX_VERSION}-nexell"

IMAGE_FSTYPES ?= "tar.gz"

MACHINE_FEATURES = "usbgadget usbhost alsa emmc sdio"
```

## meta-nxp3220/conf/machine/include/nxp3220_common.inc
```bitbake
#@TYPE: COMMON
#
# Environments for agetty (automatic login)
AGETTY_AUTOLOGIN_INITTAB_ARGUMENTS ?= "--autologin root 115200 ttyS2"

#
# Environments for disk partition images
#
PART_BOOT_LABEL ?= "boot"
PART_BOOT_SIZE ?= ""
PART_BOOT_IMAGE ?= "boot.img"

PART_ROOTFS_LABEL ?= "rootfs"
PART_ROOTFS_SIZE ?= ""
PART_ROOTFS_IMAGE ?= "rootfs.img"

PART_DATA_LABEL ?= "data"
PART_DATA_SIZE ?= ""
PART_DATA_IMAGE ?= "userdata.img"
# for fstab to auto mount at boot-time
PART_DATA_NODE ?= "/dev/mmcblk0p4"

# for misc partition image
PART_MISC_LABEL ?= "misc"
PART_MISC_SIZE ?= ""
PART_MISC_IMAGE ?= "misc.img"
# for fstab to auto mount at boot-time
PART_MISC_NODE ?= ""

# for recovery filesystem
RECOVERY_IMAGE ?= "recovery.uinitrd"

# for flash (NAND) parameter
FLASH_PAGE_SIZE ?= ""
FLASH_BLOCK_SIZE ?= ""
FLASH_DEVICE_SIZE ?= ""

# for flash ubi images
# IMAGE_CLASSES += " nexell-image-types"
# IMAGE_FSTYPES += " multiubi2"
# IMAGE_FSTYPES_DEBUGFS += " multiubi2"
# KUBIFS_ARGS_<type> options : Each partition is separated by ','
#  -r : input root filesystem for ubi image
#  -v : ubi volume/output name (<volume name>.img)
#  -i : ubi volume id
#  -l : ubi volume size
#
# Reserved ubi images type
#  boot.img    : MKUBIFS_ARGS_boot = "-r ${DEPLOY_DIR_IMAGE}/boot -v boot -i <id> -l <size>"
#  rootfs.img  : MKUBIFS_ARGS_rootfs = "-r ${IMAGE_ROOTFS} -v rootfs -i <id> -l <size>"
#  userdata.img: MKUBIFS_ARGS_data = "-r ${DEPLOY_DIR_IMAGE}/data -v userdata -i <id> -l <size>"
#  misc.img    : MKUBIFS_ARGS_misc = "-r ${DEPLOY_DIR_IMAGE}/misc -v misc -i <id> -l <size>"
#  Note>
#   If use 'MKUBIFS_ARGS_data' and want automount at boot-time for data partition,
#   you must be set 'PART_DATA_NODE = "ubiX:data"' for "/etc/fstab".
#   If use 'MKUBIFS_ARGS_misc' and want automount at boot-time for misc partition,
#   you must be set 'PART_MISC_NODE = "ubiX:misc"' for "/etc/fstab".

#
# Environments for recovery with SWUpdate
#
# Depend swupdate build config at meta-nxp3220/recipes-bbappend/swupdate/files/defconfig
#
# SWUpdate recipe:
#  DISTRO_FEATURES_append = " swupdate"
# -Set swupdate version
#  PREFERRED_VERSION_swupdate = "2019.11"
#
# General options for image:
# -Set swupdate output image name, default nxp3220-1.0.swu
#  SWU_UPDATE_SWU_IMAGE = "nxp3220-1.0.swu"
# -Set sw-description file
#  SWU_SWDESCRIPTION = "${BSP_ROOT_DIR}/tools/files/sw-description"
# -Set script files in sw-description
#  SWU_SCRIPT_FILES = "${BSP_ROOT_DIR}/tools/files/swu-script.sh"
#
# -Install versions to /etc/hwrevision, /etc/sw-versions:
#  SWU_HW_REVISION_TARGET = "nxp3220 2.0"
#  SWU_SW_VERSION_FILE = "${BSP_ROOT_DIR}/tools/files/sw-version_n.x"
#
# Signing options for image:
# -Enable signing with password
#  SWU_SIGN_ENABLE = "true"  <- sha256 with no password
#  SWU_SIGN_PASSWORD = "nxp3220" <- aes256 with password
# -Set private key file to signing swuimage
#  SWU_SIGN_PRIVATE_KEY = "${BSP_ROOT_DIR}/tools/files/swu.private.key"
# -Install public key file to /etc/swu.public.key
#  SWU_SIGN_PUBLIC_KEY = "${BSP_ROOT_DIR}/tools/files/swu.public.key"
#
# Replace services with 'recipes-bbappend/swupdate/files/swupdate, ...'
#  SWU_DAEMON_SERVICES_REPLACE = "true"
# Service options:
# swupdate options : -k <key>: public key file, -v: verbose, -n: not install -l <num>: log level
# progress options : -r: reboot, -m recovery: reboot recovery, -w: wait -p: psplash progress
#
# -Register swupdate udev rules and daemon, progress service and for swu root:
#  -udev-rules : /etc/udev/rules.d/swupdate.rules
#  -swupdate-daemon : /etc/init.d/swupdate
#  -swupdate progress service : /etc/init.d/swupdate
#  SWU_UDEV_RULES_MMC_DEVICE = "mmcblk1p[0-9]"
#  SWU_SERVICE_SWUPDATE_ROOT = "/usr/bin/swupdate -k /misc/etc/swu.public.key -i /mnt/*.swu -v -l6 -n"
#  SWU_SERVICE_PROGRESS_ROOT = "/usr/bin/swupdate-progress -r -w -m recovery"
# -Register swupdate udev rules and daemon, progress service and for recovery root:
#  -udev-rules : /etc/udev/rules.d/swupdate.rules
#  -swupdate-daemon : /etc/init.d/swupdate
#  -swupdate progress service : /etc/init.d/swupdate-progress <- /etc/rcS.d/S03swupdate-progress
#  SWU_SERVICE_SWUPDATE_RECOVERY = "/usr/bin/swupdate -k /misc/etc/swu.public.key -i /mnt/*.swu -v -l6"
#  SWU_SERVICE_PROGRESS_RECOVERY = "/usr/bin/swupdate-progress -w -r"
# -Install psplash to show update progress
#  SWU_PROGRESS_PSPLASH ?= true

# Generate swu image (SWU_UPDATE_SWU_IMAGE) with 'swu_image.sh' script and sw-description
SWU_TOOL_IMAGE_GEN = "swu_image.sh"
SWU_SUPPORT_MAKE_SWU_IMAGE ?= "true"

PREFERRED_VERSION_swupdate ?= "2019.11"
SWU_DAEMON_SERVICES_REPLACE ?= "true"
SWU_RECOVERY_ROOTFS_IMAGE ?= "nexell-recoveryimg-${MACHINE_ARCH}.cpio.gz.u-boot"

SWU_UPDATE_SWU_IMAGE ?= "nxp3220-image-2.0.swu"
SWU_SWDESCRIPTION ?= "${BSP_ROOT_DIR}/tools/files/swu-sw-description_emmc"
SWU_SCRIPT_FILES ?= "${BSP_ROOT_DIR}/tools/files/swu-script-preinstall.sh ${BSP_ROOT_DIR}/tools/files/swu-script-postinstall.sh"
SWU_HW_REVISION_TARGET ?= "nxp3220 2.0"
SWU_SW_VERSION_FILE ?= "${BSP_ROOT_DIR}/tools/files/swu-sw-versions_2.0"
SWU_SIGN_PASSWORD ?= "nxp3220"
SWU_SIGN_PRIVATE_KEY ?= "${BSP_ROOT_DIR}/tools/files/swu.private.key"
SWU_SIGN_PUBLIC_KEY ?= "${BSP_ROOT_DIR}/tools/files/swu.public.key"

SWU_SERVICE_SWUPDATE_RECOVERY ?= "/usr/bin/swupdate -k /misc/etc/swu.public.key -i /mnt/*.swu -v -l6"
SWU_SERVICE_PROGRESS_RECOVERY ?= "/usr/bin/swupdate-progress -r -w"

SWU_PROGRESS_PSPLASH ?= "false"

#
# Environments for devices
#
# for bluethooth
BSA_SERVICE_COMMAND ?= "/usr/bin/bsa_server -d /dev/ttyS0 -p /etc/bluetooth/BCM434545.hcd -all=0"
```

## meta-nxp3220/conf/machine/include/nxp3220_machine.inc
```bitbake
#@TYPE: Machine
#@NAME: nxp3220

NEXELL_BOARD_SOCNAME = "nxp3220"

BSP_BIN_PATH ?= "${BSP_ROOT_DIR}/tools/bin"
BSP_FILES_PATH ?= "${BSP_ROOT_DIR}/tools/files"
BSP_SCRIPTS_PATH ?= "${BSP_ROOT_DIR}/tools/scripts"

# tools
TOOL_BINGEN ?= "${BSP_BIN_PATH}/bingen"
TOOL_BINECC ?= "${BSP_BIN_PATH}/nandbingen"
TOOL_BINENC = "openssl"

# secure keys
SECURE_BOOTKEY ?= "${BSP_FILES_PATH}/secure-bootkey.pem"
SECURE_USERKEY ?= "${BSP_FILES_PATH}/secure-userkey.pem"
SECURE_BL1_ENCKEY ?= "${BSP_FILES_PATH}/secure-bl1-enckey.txt"
SECURE_BL1_IVECTOR = "${BSP_FILES_PATH}/secure-bl1-ivector.txt"
SECURE_BL32_ENCKEY ?= "${BSP_FILES_PATH}/secure-bl32-enckey.txt"

# for u-boot
# set BINARY_FEATURES_pn-u-boot-2018.5-nexell = "nand.ecc" for ecc image
UBOOT_BIN ?= "u-boot.bin"
UBOOT_NSIH ?= "${BSP_FILES_PATH}/nsih_uboot.txt"
UBOOT_LOADADDR ?= "0x43c00000"
UBOOT_LOGO_BMP ?= "${BSP_FILES_PATH}/logo.bmp"

# for BL1
# set BINARY_FEATURES_pn-bl1-nxp3220 = "nand.ecc" for ecc image
BL1_SOURCE ?= "${BSP_ROOT_DIR}/firmwares/binary"
BL1_BIN ?= "bl1-nxp3220.bin"
BL1_LOADADDR ?= "0xFFFF0000"
BL1_NSIH ?= "${BSP_FILES_PATH}/nsih_bl1.txt"

# for BL2
# Note: BL2_LOADADDR is fixed
# set BINARY_FEATURES_pn-bl2-nxp3220 = "nand.ecc" for ecc image
BL2_CHIP ?= "nxp3220"
BL2_PMIC ?= "nxe1500"
BL2_BIN ?= "bl2-${BL2_BOARD}.bin"
BL2_LOADADDR ?= "0xFFFF9000"
BL2_SOURCE ?= "${BSP_ROOT_DIR}/firmwares/bl2-nxp3220"
BL2_NSIH ?= "${BL2_SOURCE}/reference-nsih/nsih_evb_ddr3_800Mhz.txt"

# for BL32
# set BINARY_FEATURES_pn-bl32-nxp3220 = "nand.ecc" for ecc image
BL32_LOADADDR ?= "0x5F000000"
BL32_BIN ?= "bl32.bin"
BL32_SOURCE ?= "${BSP_ROOT_DIR}/firmwares/bl32-nxp3220"
BL32_NSIH ?= "${BL32_SOURCE}/reference-nsih/nsih_general.txt"
```

## meta-nxp3220/conf/machine/nxp3220-daudio.conf
```bitbake
#@TYPE: Machine
#@NAME: nxp3220

#@DESCRIPTION: Machine configuration for nxp3220 systems
require conf/machine/include/nxp3220.inc
require conf/machine/include/nxp3220_common.inc

# kerne features
KBUILD_DEFCONFIG = "nxp3220_daudio_defconfig"
KERNEL_IMAGETYPE = "Image"
KERNEL_DEVICETREE = "nxp3220-daudio.dtb"

# u-boot features: defconfig, nsih load/lauch adddr
UBOOT_MACHINE = "nxp3220_daudio_defconfig"
UBOOT_LOADADDR = "0x43c00000"

# rootfs features
IMAGE_ROOTFS_SIZE = "32768"

# bl2 board name
BL2_BOARD = "evb"

# bl32 load/launch address
BL32_LOADADDR = "0x5F000000"

# disk images features
PART_BOOT_SIZE = "32M"
PART_ROOTFS_SIZE = "1G"
PART_DATA_SIZE = "6G"

# for bluetooth
BSA_SERVICE_COMMAND = "/usr/bin/bsa_server -d /dev/ttyS0 -p /etc/bluetooth/BCM434545.hcd -all=0"

# for touchscreen device
TSDEVICE = "/dev/input/event1"
EVDEV_TOUCHSCREEN_PARAMETERS = "tslib:/dev/input/event1:invertx:rotate=180"
```

## meta-nxp3220/conf/machine/nxp3220-evb.conf
```bitbake
#@TYPE: Machine
#@NAME: nxp3220

#@DESCRIPTION: Machine configuration for nxp3220 systems
require conf/machine/include/nxp3220.inc
require conf/machine/include/nxp3220_common.inc

# kerne features
KBUILD_DEFCONFIG = "nxp3220_evb_defconfig"
KERNEL_IMAGETYPE = "zImage"
KERNEL_DEVICETREE = "nxp3220-evb.dtb"

# u-boot features
UBOOT_MACHINE = "nxp3220_evb_defconfig"

# rootfs features
IMAGE_ROOTFS_SIZE = "32768"

# bl2 board name
BL2_BOARD = "evb"

# disk images features
PART_BOOT_LABEL = "boot"
PART_BOOT_SIZE = "32M"

PART_ROOTFS_LABEL = "rootfs"
PART_ROOTFS_SIZE = "800M"
```

## meta-nxp3220/conf/machine/nxp3220.conf
```bitbake
#@TYPE: Machine
#@NAME: nxp3220

MACHINE = "nxp3220"

#@DESCRIPTION: Machine configuration for nxp3220 systems
require conf/machine/include/nxp3220.inc
require conf/machine/include/nxp3220_machine.inc
require conf/machine/include/nxp3220_common.inc
```
